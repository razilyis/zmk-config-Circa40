## config/boards/shields/circa40/Kconfig.defconfig
```kconfig
if SHIELD_CIRCA40_LEFT || SHIELD_CIRCA40_RIGHT

config ZMK_SPLIT
    default y

endif

if SHIELD_CIRCA40_RIGHT

config ZMK_KEYBOARD_NAME
    default "Circa40"

config ZMK_SPLIT_ROLE_CENTRAL
    default y

endif
```

## config/boards/shields/circa40/Kconfig.shield
```kconfig
config SHIELD_CIRCA40_LEFT
    def_bool $(shields_list_contains,circa40_left)

config SHIELD_CIRCA40_RIGHT
    def_bool $(shields_list_contains,circa40_right)
```
