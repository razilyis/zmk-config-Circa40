#include "circa40.dtsi"

&kscan0 {
    row-gpios = <&gpio1 1 (GPIO_ACTIVE_HIGH | GPIO_PULL_DOWN)>,
                <&gpio1 7 (GPIO_ACTIVE_HIGH | GPIO_PULL_DOWN)>,
                <&gpio1 5 (GPIO_ACTIVE_HIGH | GPIO_PULL_DOWN)>,
                <&gpio1 3 (GPIO_ACTIVE_HIGH | GPIO_PULL_DOWN)>;
    col-gpios = <&gpio0 2 GPIO_ACTIVE_HIGH>,
                <&gpio0 3 GPIO_ACTIVE_HIGH>,
                <&gpio0 28 GPIO_ACTIVE_HIGH>,
                <&gpio0 29 GPIO_ACTIVE_HIGH>,
                <&gpio0 15 GPIO_ACTIVE_HIGH>,
                <&gpio0 19 GPIO_ACTIVE_HIGH>;
};

